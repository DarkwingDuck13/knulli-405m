## configs/batocera-rg405m_defconfig
```kconfig
BR2_aarch64=y
BR2_cortex_a55=y

# System Identity
BR2_TARGET_GENERIC_HOSTNAME="Knulli-RG405M"
BR2_TARGET_GENERIC_ISSUE="Welcome to Knulli (RG405M)"

# Toolchain & Headers Configuration
# Decoupled from custom kernel git to prevent download 404s
# BR2_KERNEL_HEADERS_AS_KERNEL is not set
BR2_KERNEL_HEADERS_4_14=y
BR2_PACKAGE_HOST_LINUX_HEADERS_CUSTOM_4_14=y

# Kernel Source Configuration
BR2_LINUX_KERNEL=y
BR2_LINUX_KERNEL_CUSTOM_GIT=y
BR2_LINUX_KERNEL_CUSTOM_REPO_URL="https://gitlab.com/ubports/porting/community-ports/android10/ubports-kernel-ums512.git"
BR2_LINUX_KERNEL_CUSTOM_REPO_VERSION="7d5f80b1b988f634bfca93a15f02c610e206f6ef"
BR2_LINUX_KERNEL_DEFCONFIG="ums512_defconfig"
```
